#include "../../mach-rockchip/rk_camera_sensor_info.h"
/{
	rk3126_cif_sensor: rk3126_cif_sensor{
			compatible = "rockchip,sensor";
			status = "disabled";
			CONFIG_SENSOR_POWER_IOCTL_USR 		= <1>;
			CONFIG_SENSOR_RESET_IOCTL_USR 		= <0>;
			CONFIG_SENSOR_POWERDOWN_IOCTL_USR	= <0>;
			CONFIG_SENSOR_FLASH_IOCTL_USR	  	= <0>;
			CONFIG_SENSOR_AF_IOCTL_USR	   		= <0>;

		sp0a19 {
			is_front = <1>;
			//rockchip,power = <&gpio2 GPIO_B2 GPIO_ACTIVE_HIGH>;
			rockchip,powerdown = <&gpio2 GPIO_B2 GPIO_ACTIVE_LOW>;
			pwdn_active = <sp0a19_PWRDN_ACTIVE>;
			pwr_active = <PWR_ACTIVE_HIGH>;
			mir = <0>;
			flash_attach = <0>;
			resolution = <sp0a19_FULL_RESOLUTION>;
			powerup_sequence = <sp0a19_PWRSEQ>;
			orientation = <270>;
			i2c_add = <sp0a19_I2C_ADDR>;
			i2c_rata = <200000>;
			i2c_chl = <2>;
			cif_chl = <0>;
			mclk_rate = <24>;
		};

		sp2519 {
			is_front = <0>;
			rockchip,powerdown = <&gpio3 GPIO_B3 GPIO_ACTIVE_LOW>;
			pwdn_active = <sp2519_PWRDN_ACTIVE>;
			pwr_active = <PWR_ACTIVE_HIGH>;
			mir = <0>;
			flash_attach = <0>;
			resolution = <sp2519_FULL_RESOLUTION>;
			powerup_sequence = <sp2519_PWRSEQ>;
			orientation = <90>;
			i2c_add = <sp2519_I2C_ADDR>;
			i2c_rata = <200000>;
			i2c_chl = <2>;
			cif_chl = <0>;
			mclk_rate = <24>;
		};
	};
};

